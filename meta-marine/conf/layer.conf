## meta-marine/conf/layer.conf
```bitbake
# We have a conf and classes directory, add to BBPATH
BBPATH .= ":${LAYERDIR}"

# We have recipes-* directories, add to BBFILES
BBFILES += "${LAYERDIR}/recipes-*/*/*.bb \
            ${LAYERDIR}/recipes-*/*/*.bbappend"

BBFILE_COLLECTIONS += "marine"
BBFILE_PATTERN_marine = "^${LAYERDIR}/"
BBFILE_PRIORITY_marine = "1"

LAYERVERSION_marine = "1"

LAYERSERIES_COMPAT_marine = "whinlatter"
LAYERDEPENDS_marine = "core meta-arm rockchip"
```
